/dts-v1/;
/plugin/;

/ {
    fragment@avf {
        target-path = "/";

        __overlay__ {
            avf {
                guest {
                    common {
                        ramdump = <0>;
                    };
                };
            };
        };
    };
};